## esp32_bridge/firmware/main/Kconfig.projbuild
```kconfig
menu "POV bridge configuration"

config POV_WIFI_SSID
    string "WiFi SSID"
    default "undef"
    help
        SSID to connect to as STA.

config POV_WIFI_PASSWORD
    string "WiFi password"
    default "undefoffice1010"
    help
        WPA2 password.

endmenu
```

## esp32_bridge/firmware/sdkconfig.defaults
```kconfig
# Default sdkconfig for ESP32-C5 SDIO bridge.
# Override with `idf.py menuconfig`.

CONFIG_IDF_TARGET="esp32c5"

# WiFi credentials (office AP "undef")
CONFIG_POV_WIFI_SSID="undef"
CONFIG_POV_WIFI_PASSWORD="undefoffice1010"

# WiFi: prefer faster TX paths
CONFIG_ESP_WIFI_STATIC_TX_BUFFER=y
CONFIG_ESP_WIFI_TX_BUFFER_TYPE=0
CONFIG_ESP_WIFI_STATIC_TX_BUFFER_NUM=16
CONFIG_ESP_WIFI_DYNAMIC_RX_BUFFER_NUM=32

# lwip: TCP send buf bumped for streaming
CONFIG_LWIP_TCP_SND_BUF_DEFAULT=16384
CONFIG_LWIP_TCP_WND_DEFAULT=16384

# SDIO slave is in driver component (driver/sdio_slave.h) and is enabled
# implicitly by linking, no Kconfig switch needed on IDF v5.3+.

# Reduce stray serial console noise (we use mDNS / TCP for diagnostics)
CONFIG_ESP_CONSOLE_UART_BAUDRATE=115200

# Stack sizes
CONFIG_ESP_MAIN_TASK_STACK_SIZE=4096
# === High-throughput WiFi tweaks (POV3D bridge bench) ===
CONFIG_ESP_WIFI_STATIC_RX_BUFFER_NUM=16
CONFIG_ESP_WIFI_DYNAMIC_RX_BUFFER_NUM=64
CONFIG_ESP_WIFI_RX_BA_WIN=16
CONFIG_LWIP_TCP_WND_DEFAULT=65535
CONFIG_LWIP_TCP_SND_BUF_DEFAULT=65535
CONFIG_LWIP_TCP_RECVMBOX_SIZE=48
CONFIG_LWIP_TCPIP_RECVMBOX_SIZE=48
CONFIG_LWIP_UDP_RECVMBOX_SIZE=64
CONFIG_LWIP_WND_SCALE=y
CONFIG_LWIP_TCP_RCV_SCALE=3
# === iperf example throughput tweaks (借鉴 IDF iperf sdkconfig 测出 30Mbps) ===
CONFIG_LWIP_IRAM_OPTIMIZATION=y
CONFIG_LWIP_TCPIP_CORE_LOCKING=y
CONFIG_LWIP_TCPIP_CORE_LOCKING_INPUT=y
CONFIG_LWIP_TCPIP_TASK_PRIO=23
CONFIG_LWIP_IP_REASS_MAX_PBUFS=15

# SDIO ISR + low-level interrupt handler in IRAM (从 IDF example sdkconfig 借鉴)
# 没有这些, SDIO ISR 走 flash 太慢, 跟 WiFi 共存时 CMD response 错过
CONFIG_ESP_INTR_IN_IRAM=y
CONFIG_ESP_HW_SUPPORT_FUNC_IN_IRAM=y
CONFIG_LIBC_LOCKS_PLACE_IN_IRAM=y
CONFIG_RTC_CLK_FUNC_IN_IRAM=y

# === Speed guide v5.5 (POV3D) === DISABLED 2026-05-12 SDIO debug
# 怀疑 IRAM_OPTIMIZATION / TCPIP_CORE_LOCKING 影响 SDIO ISR
# CONFIG_COMPILER_OPTIMIZATION_PERF=y
# CONFIG_COMPILER_OPTIMIZATION_ASSERTIONS_DISABLE=y
# CONFIG_COMPILER_OPTIMIZATION_ASSERTION_LEVEL=0
# CONFIG_ESP_WIFI_PS_NONE=y
# CONFIG_ESP_WIFI_AMSDU_TX_ENABLED=y
# CONFIG_ESP_WIFI_DYNAMIC_RX_BUFFER_NUM=128
# CONFIG_ESP_WIFI_DYNAMIC_TX_BUFFER_NUM=64
# CONFIG_ESP_WIFI_RX_BA_WIN=32
# CONFIG_LWIP_IRAM_OPTIMIZATION=y
# CONFIG_LWIP_TCPIP_CORE_LOCKING=y
# CONFIG_LWIP_TCP_SACK_OUT=y
# CONFIG_LWIP_TCPIP_TASK_STACK_SIZE=4096
# CONFIG_LWIP_TCP_MSS=1460
# CONFIG_LWIP_UDP_RECVMBOX_SIZE=64
```
